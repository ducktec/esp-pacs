# ESP32-S3 register map
Vendor: ESPRESSIF SYSTEMS (SHANGHAI) CO., LTD.; Series: ESP32-S3; File version: 7
CPU: Xtensa LX7 r0p0, little endian, no MPU, FPU, 3 interrupt priority bits
Address unit: 32 bits
Registers are 32-bit, read-write, reset 0x0 unless marked. A register's access mark holds for its fields unless they carry their own. Offsets are from the block's base; [hi:lo] are bit positions; {n}, {i} and the like mark numbered series.

## INTERRUPT_CORE0 — Interrupt Core
Base 0x600C2000
0x00 PRO_MAC_INTR_MAP reset 0x10 — mac interrupt configuration register
  [4:0] MAC_INTR_MAP — this register used to map mac interrupt to one of core0's external interrupt
0x04 MAC_NMI_MAP reset 0x10 — mac_nmi interrupt configuration register
  [4:0] MAC_NMI_MAP — this register used to map_nmi interrupt to one of core0's external interrupt
0x08 PWR_INTR_MAP reset 0x10 — pwr interrupt configuration register
  [4:0] PWR_INTR_MAP — this register used to map pwr interrupt to one of core0's external interrupt
0x0C BB_INT_MAP reset 0x10 — bb interrupt configuration register
  [4:0] BB_INT_MAP — this register used to map bb interrupt to one of core0's external interrupt
0x10 BT_MAC_INT_MAP reset 0x10 — bb_mac interrupt configuration register
  [4:0] BT_MAC_INT_MAP — this register used to map bb_mac interrupt to one of core0's external interrupt
0x14 BT_BB_INT_MAP reset 0x10 — bt_bb interrupt configuration register
  [4:0] BT_BB_INT_MAP — this register used to map bt_bb interrupt to one of core0's external interrupt
0x18 BT_BB_NMI_MAP reset 0x10 — bt_bb_nmi interrupt configuration register
  [4:0] BT_BB_NMI_MAP — this register used to map bb_bt_nmi interrupt to one of core0's external interrupt
0x1C RWBT_IRQ_MAP reset 0x10 — rwbt_irq interrupt configuration register
  [4:0] RWBT_IRQ_MAP — this register used to map rwbt_irq interrupt to one of core0's external interrupt
0x20 RWBLE_IRQ_MAP reset 0x10 — rwble_irq interrupt configuration register
  [4:0] RWBLE_IRQ_MAP — this register used to map rwble_irq interrupt to one of core0's external interrupt
0x24 RWBT_NMI_MAP reset 0x10 — rwbt_nmi interrupt configuration register
  [4:0] RWBT_NMI_MAP — this register used to map mac rwbt_nmi to one of core0's external interrupt
0x28 RWBLE_NMI_MAP reset 0x10 — rwble_nmi interrupt configuration register
  [4:0] RWBLE_NMI_MAP — this register used to map rwble_nmi interrupt to one of core0's external interrupt
0x2C I2C_MST_INT_MAP reset 0x10 — i2c_mst interrupt configuration register
  [4:0] I2C_MST_INT_MAP — this register used to map i2c_mst interrupt to one of core0's external interrupt
0x30 SLC0_INTR_MAP reset 0x10 — slc0 interrupt configuration register
  [4:0] SLC0_INTR_MAP — this register used to map slc0 interrupt to one of core0's external interrupt
0x34 SLC1_INTR_MAP reset 0x10 — slc1 interrupt configuration register
  [4:0] SLC1_INTR_MAP — this register used to map slc1 interrupt to one of core0's external interrupt
0x38 UHCI0_INTR_MAP reset 0x10 — uhci0 interrupt configuration register
  [4:0] UHCI0_INTR_MAP — this register used to map uhci0 interrupt to one of core0's external interrupt
0x3C UHCI1_INTR_MAP reset 0x10 — uhci1 interrupt configuration register
  [4:0] UHCI1_INTR_MAP — this register used to map uhci1 interrupt to one of core0's external interrupt
0x40 GPIO_INTERRUPT_PRO_MAP reset 0x10 — gpio_interrupt_pro interrupt configuration register
  [4:0] GPIO_INTERRUPT_PRO_MAP — this register used to map gpio_interrupt_pro interrupt to one of core0's external interrupt
0x44 GPIO_INTERRUPT_PRO_NMI_MAP reset 0x10 — gpio_interrupt_pro_nmi interrupt configuration register
  [4:0] GPIO_INTERRUPT_PRO_NMI_MAP — this register used to map gpio_interrupt_pro_nmi interrupt to one of core0's external interrupt
0x48 GPIO_INTERRUPT_APP_MAP reset 0x10 — gpio_interrupt_app interrupt configuration register
  [4:0] GPIO_INTERRUPT_APP_MAP — this register used to map gpio_interrupt_app interrupt to one of core0's external interrupt
0x4C GPIO_INTERRUPT_APP_NMI_MAP reset 0x10 — gpio_interrupt_app_nmi interrupt configuration register
  [4:0] GPIO_INTERRUPT_APP_NMI_MAP — this register used to map gpio_interrupt_app_nmi interrupt to one of core0's external interrupt
{0x4C+4i} SPI_INTR_{i}_MAP reset 0x10 (i=1..4) — spi_intr_{i} interrupt configuration register
  [4:0] SPI_INTR_{i}_MAP — this register used to map spi_intr_{i} interrupt to one of core0's external interrupt
0x60 LCD_CAM_INT_MAP reset 0x10 — lcd_cam interrupt configuration register
  [4:0] LCD_CAM_INT_MAP — this register used to map lcd_cam interrupt to one of core0's external interrupt
0x64 I2S0_INT_MAP reset 0x10 — i2s0 interrupt configuration register
  [4:0] I2S0_INT_MAP — this register used to map i2s0 interrupt to one of core0's external interrupt
0x68 I2S1_INT_MAP reset 0x10 — i2s1 interrupt configuration register
  [4:0] I2S1_INT_MAP — this register used to map i2s1 interrupt to one of core0's external interrupt
0x6C UART_INTR_MAP reset 0x10 — uart interrupt configuration register
  [4:0] UART_INTR_MAP — this register used to map uart interrupt to one of core0's external interrupt
0x70 UART1_INTR_MAP reset 0x10 — uart1 interrupt configuration register
  [4:0] UART1_INTR_MAP — this register used to map uart1 interrupt to one of core0's external interrupt
0x74 UART2_INTR_MAP reset 0x10 — uart2 interrupt configuration register
  [4:0] UART2_INTR_MAP — this register used to map uart2 interrupt to one of core0's external interrupt
0x78 SDIO_HOST_INTERRUPT_MAP reset 0x10 — sdio_host interrupt configuration register
  [4:0] SDIO_HOST_INTERRUPT_MAP — this register used to map sdio_host interrupt to one of core0's external interrupt
{0x7C+4i} PWM{i}_INTR_MAP reset 0x10 (i=0..3) — pwm{i} interrupt configuration register
  [4:0] PWM{i}_INTR_MAP — this register used to map pwm{i} interrupt to one of core0's external interrupt
0x8C LEDC_INT_MAP reset 0x10 — ledc interrupt configuration register
  [4:0] LEDC_INT_MAP — this register used to map ledc interrupt to one of core0's external interrupt
0x90 EFUSE_INT_MAP reset 0x10 — efuse interrupt configuration register
  [4:0] EFUSE_INT_MAP — this register used to map efuse interrupt to one of core0's external interrupt
0x94 CAN_INT_MAP reset 0x10 — can interrupt configuration register
  [4:0] CAN_INT_MAP — this register used to map can interrupt to one of core0's external interrupt
0x98 USB_INTR_MAP reset 0x10 — usb interrupt configuration register
  [4:0] USB_INTR_MAP — this register used to map usb interrupt to one of core0's external interrupt
0x9C RTC_CORE_INTR_MAP reset 0x10 — rtc_core interrupt configuration register
  [4:0] RTC_CORE_INTR_MAP — this register used to map rtc_core interrupt to one of core0's external interrupt
0xA0 RMT_INTR_MAP reset 0x10 — rmt interrupt configuration register
  [4:0] RMT_INTR_MAP — this register used to map rmt interrupt to one of core0's external interrupt
0xA4 PCNT_INTR_MAP reset 0x10 — pcnt interrupt configuration register
  [4:0] PCNT_INTR_MAP — this register used to map pcnt interrupt to one of core0's external interrupt
0xA8 I2C_EXT0_INTR_MAP reset 0x10 — i2c_ext0 interrupt configuration register
  [4:0] I2C_EXT0_INTR_MAP — this register used to map i2c_ext0 interrupt to one of core0's external interrupt
0xAC I2C_EXT1_INTR_MAP reset 0x10 — i2c_ext1 interrupt configuration register
  [4:0] I2C_EXT1_INTR_MAP — this register used to map i2c_ext1 interrupt to one of core0's external interrupt
{0xA8+4i} SPI{i}_DMA_INT_MAP reset 0x10 (i=2..4) — spi{i}_dma interrupt configuration register
  [4:0] SPI{i}_DMA_INT_MAP — this register used to map spi{i}_dma interrupt to one of core0's external interrupt
0xBC WDG_INT_MAP reset 0x10 — wdg interrupt configuration register
  [4:0] WDG_INT_MAP — this register used to map wdg interrupt to one of core0's external interrupt
0xC0 TIMER_INT1_MAP reset 0x10 — timer_int1 interrupt configuration register
  [4:0] TIMER_INT1_MAP — this register used to map timer_int1 interrupt to one of core0's external interrupt
0xC4 TIMER_INT2_MAP reset 0x10 — timer_int2 interrupt configuration register
  [4:0] TIMER_INT2_MAP — this register used to map timer_int2 interrupt to one of core0's external interrupt
0xC8 TG_T0_INT_MAP reset 0x10 — tg_t0 interrupt configuration register
  [4:0] TG_T0_INT_MAP — this register used to map tg_t0 interrupt to one of core0's external interrupt
0xCC TG_T1_INT_MAP reset 0x10 — tg_t1 interrupt configuration register
  [4:0] TG_T1_INT_MAP — this register used to map tg_t1 interrupt to one of core0's external interrupt
0xD0 TG_WDT_INT_MAP reset 0x10 — tg_wdt interrupt configuration register
  [4:0] TG_WDT_INT_MAP — this register used to map rg_wdt interrupt to one of core0's external interrupt
0xD4 TG1_T0_INT_MAP reset 0x10 — tg1_t0 interrupt configuration register
  [4:0] TG1_T0_INT_MAP — this register used to map tg1_t0 interrupt to one of core0's external interrupt
0xD8 TG1_T1_INT_MAP reset 0x10 — tg1_t1 interrupt configuration register
  [4:0] TG1_T1_INT_MAP — this register used to map tg1_t1 interrupt to one of core0's external interrupt
0xDC TG1_WDT_INT_MAP reset 0x10 — tg1_wdt interrupt configuration register
  [4:0] TG1_WDT_INT_MAP — this register used to map tg1_wdt interrupt to one of core0's external interrupt
0xE0 CACHE_IA_INT_MAP reset 0x10 — cache_ia interrupt configuration register
  [4:0] CACHE_IA_INT_MAP — this register used to map cache_ia interrupt to one of core0's external interrupt
{0xE4+4i} SYSTIMER_TARGET{i}_INT_MAP reset 0x10 (i=0..2) — systimer_target{i} interrupt configuration register
  [4:0] SYSTIMER_TARGET{i}_INT_MAP — this register used to map systimer_target{i} interrupt to one of core0's external interrupt
0xF0 SPI_MEM_REJECT_INTR_MAP reset 0x10 — spi_mem_reject interrupt configuration register
  [4:0] SPI_MEM_REJECT_INTR_MAP — this register used to map spi_mem_reject interrupt to one of core0's external interrupt
0xF4 DCACHE_PRELOAD_INT_MAP reset 0x10 — dcache_prelaod interrupt configuration register
  [4:0] DCACHE_PRELOAD_INT_MAP — this register used to map dcache_prelaod interrupt to one of core0's external interrupt
0xF8 ICACHE_PRELOAD_INT_MAP reset 0x10 — icache_preload interrupt configuration register
  [4:0] ICACHE_PRELOAD_INT_MAP — this register used to map icache_preload interrupt to one of core0's external interrupt
0xFC DCACHE_SYNC_INT_MAP reset 0x10 — dcache_sync interrupt configuration register
  [4:0] DCACHE_SYNC_INT_MAP — this register used to map dcache_sync interrupt to one of core0's external interrupt
0x100 ICACHE_SYNC_INT_MAP reset 0x10 — icache_sync interrupt configuration register
  [4:0] ICACHE_SYNC_INT_MAP — this register used to map icache_sync interrupt to one of core0's external interrupt
0x104 APB_ADC_INT_MAP reset 0x10 — apb_adc interrupt configuration register
  [4:0] APB_ADC_INT_MAP — this register used to map apb_adc interrupt to one of core0's external interrupt
{0x108+4i} DMA_IN_CH{i}_INT_MAP reset 0x10 (i=0..4) — dma_in_ch{i} interrupt configuration register
  [4:0] DMA_IN_CH{i}_INT_MAP — this register used to map dma_in_ch{i} interrupt to one of core0's external interrupt
{0x11C+4i} DMA_OUT_CH{i}_INT_MAP reset 0x10 (i=0..4) — dma_out_ch{i} interrupt configuration register
  [4:0] DMA_OUT_CH{i}_INT_MAP — this register used to map dma_out_ch{i} interrupt to one of core0's external interrupt
0x130 RSA_INT_MAP reset 0x10 — rsa interrupt configuration register
  [4:0] RSA_INT_MAP — this register used to map rsa interrupt to one of core0's external interrupt
0x134 AES_INT_MAP reset 0x10 — aes interrupt configuration register
  [4:0] AES_INT_MAP — this register used to map aes interrupt to one of core0's external interrupt
0x138 SHA_INT_MAP reset 0x10 — sha interrupt configuration register
  [4:0] SHA_INT_MAP — this register used to map sha interrupt to one of core0's external interrupt
{0x13C+4i} CPU_INTR_FROM_CPU_{i}_MAP reset 0x10 (i=0..3) — cpu_intr_from_cpu_{i} interrupt configuration register
  [4:0] CPU_INTR_FROM_CPU_{i}_MAP — this register used to map cpu_intr_from_cpu_{i} interrupt to one of core0's external interrupt
0x14C ASSIST_DEBUG_INTR_MAP reset 0x10 — assist_debug interrupt configuration register
  [4:0] ASSIST_DEBUG_INTR_MAP — this register used to map assist_debug interrupt to one of core0's external interrupt
0x150 DMA_APBPERI_PMS_MONITOR_VIOLATE_INTR_MAP reset 0x10 — dma_pms_monitor_violatile interrupt configuration register
  [4:0] DMA_APBPERI_PMS_MONITOR_VIOLATE_INTR_MAP — this register used to map dma_pms_monitor_violatile interrupt to one of core0's external interrupt
0x154 CORE_0_IRAM0_PMS_MONITOR_VIOLATE_INTR_MAP reset 0x10 — core0_IRam0_pms_monitor_violatile interrupt configuration register
  [4:0] CORE_0_IRAM0_PMS_MONITOR_VIOLATE_INTR_MAP — this register used to map core0_IRam0_pms_monitor_violatile interrupt to one of core0's external interrupt
0x158 CORE_0_DRAM0_PMS_MONITOR_VIOLATE_INTR_MAP reset 0x10 — core0_DRam0_pms_monitor_violatile interrupt configuration register
  [4:0] CORE_0_DRAM0_PMS_MONITOR_VIOLATE_INTR_MAP — this register used to map core0_DRam0_pms_monitor_violatile interrupt to one of core0's external interrupt
0x15C CORE_0_PIF_PMS_MONITOR_VIOLATE_INTR_MAP reset 0x10 — core0_PIF_pms_monitor_violatile interrupt configuration register
  [4:0] CORE_0_PIF_PMS_MONITOR_VIOLATE_INTR_MAP — this register used to map core0_PIF_pms_monitor_violatile interrupt to one of core0's external interrupt
0x160 CORE_0_PIF_PMS_MONITOR_VIOLATE_SIZE_INTR_MAP reset 0x10 — core0_PIF_pms_monitor_violatile_size interrupt configuration register
  [4:0] CORE_0_PIF_PMS_MONITOR_VIOLATE_SIZE_INTR_MAP — this register used to map core0_PIF_pms_monitor_violatile_size interrupt to one of core0's external interrupt
0x164 CORE_1_IRAM0_PMS_MONITOR_VIOLATE_INTR_MAP reset 0x10 — core1_IRam0_pms_monitor_violatile interrupt configuration register
  [4:0] CORE_1_IRAM0_PMS_MONITOR_VIOLATE_INTR_MAP — this register used to map core1_IRam0_pms_monitor_violatile interrupt to one of core0's external interrupt
0x168 CORE_1_DRAM0_PMS_MONITOR_VIOLATE_INTR_MAP reset 0x10 — core1_DRam0_pms_monitor_violatile interrupt configuration register
  [4:0] CORE_1_DRAM0_PMS_MONITOR_VIOLATE_INTR_MAP — this register used to map core1_DRam0_pms_monitor_violatile interrupt to one of core0's external interrupt
0x16C CORE_1_PIF_PMS_MONITOR_VIOLATE_INTR_MAP reset 0x10 — core1_PIF_pms_monitor_violatile interrupt configuration register
  [4:0] CORE_1_PIF_PMS_MONITOR_VIOLATE_INTR_MAP — this register used to map core1_PIF_pms_monitor_violatile interrupt to one of core0's external interrupt
0x170 CORE_1_PIF_PMS_MONITOR_VIOLATE_SIZE_INTR_MAP reset 0x10 — core1_PIF_pms_monitor_violatile_size interrupt configuration register
  [4:0] CORE_1_PIF_PMS_MONITOR_VIOLATE_SIZE_INTR_MAP — this register used to map core1_PIF_pms_monitor_violatile_size interrupt to one of core0's external interrupt
0x174 BACKUP_PMS_VIOLATE_INTR_MAP reset 0x10 — backup_pms_monitor_violatile interrupt configuration register
  [4:0] BACKUP_PMS_VIOLATE_INTR_MAP — this register used to map backup_pms_monitor_violatile interrupt to one of core0's external interrupt
0x178 CACHE_CORE0_ACS_INT_MAP reset 0x10 — cache_core0_acs interrupt configuration register
  [4:0] CACHE_CORE0_ACS_INT_MAP — this register used to map cache_core0_acs interrupt to one of core0's external interrupt
0x17C CACHE_CORE1_ACS_INT_MAP reset 0x10 — cache_core1_acs interrupt configuration register
  [4:0] CACHE_CORE1_ACS_INT_MAP — this register used to map cache_core1_acs interrupt to one of core0's external interrupt
0x180 USB_DEVICE_INT_MAP reset 0x10 — usb_device interrupt configuration register
  [4:0] USB_DEVICE_INT_MAP — this register used to map usb_device interrupt to one of core0's external interrupt
0x184 PERI_BACKUP_INT_MAP reset 0x10 — peri_backup interrupt configuration register
  [4:0] PERI_BACKUP_INT_MAP — this register used to map peri_backup interrupt to one of core0's external interrupt
0x188 DMA_EXTMEM_REJECT_INT_MAP reset 0x10 — dma_extmem_reject interrupt configuration register
  [4:0] DMA_EXTMEM_REJECT_INT_MAP — this register used to map dma_extmem_reject interrupt to one of core0's external interrupt
{0x18C+4i} PRO_INTR_STATUS_{i} ro (i=0..2) — interrupt status register
  [31:0] INTR_STATUS_{i} — this register store the status of the first 32 interrupt source
0x198 INTR_STATUS_3 ro — interrupt status register
  [31:0] INTR_STATUS_3 — this register store the status of the first 32 interrupt source
0x19C CLOCK_GATE reset 0x1
  [0] REG_CLK_EN — this register uesd to control clock-gating interupt martrix
0x7FC DATE reset 0x2012300 — version register
  [27:0] INTERRUPT_REG_DATE
