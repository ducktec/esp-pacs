# ESP32-S3 register map
Vendor: ESPRESSIF SYSTEMS (SHANGHAI) CO., LTD.; Series: ESP32-S3; File version: 7
32-bit MCU & 2.4 GHz Wi-Fi & Bluetooth 5 (LE)
CPU: Xtensa LX7 r0p0, little endian, no MPU, FPU, 3 interrupt priority bits
Address unit: 32 bits
Registers are 32-bit, read-write, reset 0x0 unless marked. A register's access mark holds for its fields unless they carry their own. Offsets are from the block's base; lines under a group give offsets from that group; [hi:lo] are bit positions; {n}, {i} and the like mark numbered series; 'fields as' and 'values as' point back to an identical list; <NAME> marks a mode.

## Memory map
0x60000000 UART0 size 0x84 — UART (Universal Asynchronous Receiver-Transmitter) Controller
0x60002000 SPI1 size 0xB4 — SPI (Serial Peripheral Interface) Controller
0x60003000 SPI0 size 0x98 — SPI (Serial Peripheral Interface) Controller
0x60004000 GPIO size 0x634 — General Purpose Input/Output
0x60004F00 GPIOSD size 0x2C — Sigma-Delta Modulation
0x60007000 EFUSE size 0x1CC — eFuse Controller
0x60008000 RTC_CNTL size 0x15C — Real Time Controller
0x60008400 RTC_IO size 0xF0 — Peripheral RTC_IO
0x60008C00 RTC_I2C size 0x7C — Peripheral RTC_I2C
0x60009000 IO_MUX size 0xCC — Input/Output Multiplexer
0x6000C000 UHCI1 size 0x88 — Universal Host Controller Interface
0x6000F000 I2S0 size 0x5C — I2S (Inter-IC Sound) Controller
0x60010000 UART1 size 0x84 — UART (Universal Asynchronous Receiver-Transmitter) Controller
0x60013000 I2C0 size 0x90 — I2C (Inter-Integrated Circuit) Controller
0x60014000 UHCI0 size 0x88 — Universal Host Controller Interface
0x60016000 RMT size 0xD0 — Remote control
0x60017000 PCNT size 0x68 — Pulse Count Controller
0x60019000 LEDC size 0xD8 — LED PWM (Pulse Width Modulation) Controller
0x6001E000 PWM0 size 0x128 — Peripheral PWM0
0x6001F000 TIMG0 size 0x8C — Timer Group
0x60020000 TIMG1 size 0x8C — Timer Group
0x60024000 SPI2 size 0x98 — SPI (Serial Peripheral Interface) Controller
0x60025000 SPI3 size 0x98 — SPI (Serial Peripheral Interface) Controller
0x60026000 APB_CTRL size 0xCC — Advanced Peripheral Bus Controller
0x60027000 I2C1 size 0x90 — I2C (Inter-Integrated Circuit) Controller
0x6002A000 PERI_BACKUP size 0x30 — Peripheral PERI_BACKUP
0x6002C000 PWM1 size 0x128
0x6002D000 I2S1 size 0x54 — I2S (Inter-IC Sound) Controller
0x6002E000 UART2 size 0x84 — UART (Universal Asynchronous Receiver-Transmitter) Controller
0x60034F6C RNG size 0x4 — Hardware random number generator
0x60038000 USB_DEVICE size 0x50 — Peripheral USB_DEVICE
0x60039000 USB_WRAP size 0xC — Peripheral USB_WRAP
0x6003A000 AES size 0xB8 — AES (Advanced Encryption Standard) Accelerator
0x6003B000 SHA size 0xB0 — SHA (Secure Hash Algorithm) Accelerator
0x6003C000 RSA size 0x834 — RSA (Rivest Shamir Adleman) Accelerator
0x6003D000 DS size 0xA5C — Digital Signature
0x6003E000 HMAC size 0xA4 — HMAC (Hash-based Message Authentication Code) Accelerator
0x6003F000 DMA size 0x320 — DMA (Direct Memory Access) Controller
0x60040000 APB_SARADC size 0x70 — Successive Approximation Register Analog to Digital Converter
0x60041000 LCD_CAM size 0x48 — Peripheral LCD_CAM
0x600C0000 SYSTEM size 0xA8
0x600C1000 SENSITIVE size 0x314 — Peripheral SENSITIVE
0x600C2000 INTERRUPT_CORE0 size 0x1A4 — Interrupt Core
0x600C2800 INTERRUPT_CORE1 size 0x1A4 — Interrupt Core
0x600C4000 EXTMEM size 0x17C — External Memory
0x600CC000 XTS_AES size 0x60 — XTS-AES-128 Flash Encryption
0x600CE000 DEBUG_ASSIST size 0x15C
0x600D0000 WCL size 0x160 — Peripheral WCL

## Interrupts
11 I2C_MST (I2C0)
14 UHCI0
16 GPIO
17 GPIO_NMI (GPIO)
20 SPI1
21 SPI2
22 SPI3
25 I2S0
26 I2S1
27 UART0
28 UART1
29 UART2
31 PWM0
32 PWM1
35 LEDC
36 EFUSE
39 RTC_CORE (RTC_CNTL)
40 RMT
41 PCNT
42 I2C_EXT0 (I2C0)
43 I2C_EXT1 (I2C1)
50 TG0_T0_LEVEL (TIMG0)
51 TG0_T1_LEVEL (TIMG0)
52 TG0_WDT_LEVEL (TIMG0)
53 TG1_T0_LEVEL (TIMG1)
54 TG1_T1_LEVEL (TIMG1)
55 TG1_WDT_LEVEL (TIMG1)
60 SPI_MEM_REJECT (SPI0)
65 APB_ADC (APB_SARADC)
66 DMA_IN_CH0 (DMA)
67 DMA_IN_CH1 (DMA)
68 DMA_IN_CH2 (DMA)
69 DMA_IN_CH3 (DMA)
70 DMA_IN_CH4 (DMA)
71 DMA_OUT_CH0 (DMA)
72 DMA_OUT_CH1 (DMA)
73 DMA_OUT_CH2 (DMA)
74 DMA_OUT_CH3 (DMA)
75 DMA_OUT_CH4 (DMA)
76 RSA
77 AES
78 SHA
83 ASSIST_DEBUG (DEBUG_ASSIST)
84 APB_PMS_MONITOR_VIOLATE (DMA)
85 CORE_0_IRAM0_PMS_MONITOR_VIOLATE (INTERRUPT_CORE0)
86 CORE_0_DRAM0_PMS_MONITOR_VIOLATE (INTERRUPT_CORE0)
87 CORE_0_PIF_PMS_MONITOR_VIOLATE (INTERRUPT_CORE0)
88 CORE_0_PIF_PMS_MONITOR_VIOLATE_SIZE (INTERRUPT_CORE0)
89 CORE_1_IRAM0_PMS_MONITOR_VIOLATE (INTERRUPT_CORE1)
90 CORE_1_DRAM0_PMS_MONITOR_VIOLATE (INTERRUPT_CORE1)
91 CORE_1_PIF_PMS_MONITOR_VIOLATE (INTERRUPT_CORE1)
92 CORE_1_PIF_PMS_MONITOR_VIOLATE_SIZE (INTERRUPT_CORE1)
94 CACHE_CORE0_ACS (INTERRUPT_CORE0)
95 CACHE_CORE1_ACS (INTERRUPT_CORE1)
96 USB_DEVICE
97 PERI_BACKUP
98 DMA_EXTMEM_REJECT (DMA)

## Licence text in the file
Copyright 2022 Espressif Systems (Shanghai) PTE LTD Licensed under the Apache License, Version 2.0 (the "License"); you may not use this file except in compliance with the License. You may obtain a copy of the License at http://www.apache.org/licenses/LICENSE-2.0 Unless required by applicable law or agreed to in writing, software distributed under the License is distributed on an "AS IS" BASIS, WITHOUT WARRANTIES OR CONDITIONS OF ANY KIND, either express or implied. See the License for the specific language governing permissions and limitations under the License.
